## drivers/misc/reset/Kconfig
```kconfig
menu "module to reset chip MSM7227A"

config RESET_MODULE
	tristate "reset the MSM7227A chip"
	default m
	help
	  Say Y here if you want to generate a reset module.
	  To compile this driver as a module, choose M here.
	  You may reset chip MSM7227A by inserting this module.
endmenu
```

## drivers/nfc/Kconfig
```kconfig
#
# Near Field Communication (NFC) devices
#

menuconfig NFC_DEVICES
	bool "Near Field Communication (NFC) devices"
	default n
	---help---
	  You'll have to say Y if your computer contains an NFC device that
	  you want to use under Linux.

	  You can say N here if you don't have any Near Field Communication
	  devices connected to your computer.

if NFC_DEVICES

config PN544_NFC
	tristate "PN544 NFC driver"
	depends on I2C
	select CRC_CCITT
	default n
	---help---
	  Say yes if you want PN544 Near Field Communication driver.
	  This is for i2c connected version. If unsure, say N here.

	  To compile this driver as a module, choose m here. The module will
	  be called pn544.

config PN544_TEST
	bool "PN544 NFC TEST"
	depends on PN544_NFC
	default n
	---help---
	  Say yes if you want to do PN544 read model id, version, selftest.....
	  This is for i2c connected version. If unsure, say N here.
endif # NFC_DEVICES
```
